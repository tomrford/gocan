VERSION "1.0"

NS_ :

BS_:

BU_: ECU Dashboard Logger

BO_ 256 Status: 8 ECU
 SG_ Counter : 0|8@1+ (1,0) [0|255] "" Dashboard
 SG_ Temperature : 8|16@1- (0.1,-40) [-40|215.5] "degC" Dashboard
 SG_ BigEndian : 31|16@0+ (1,0) [0|65535] "" Logger
 SG_ Ratio : 32|32@1+ (1,0) [0|1] "" Logger

BO_ 2149235934 FastStatus: 8 ECU
 SG_ Payload : 0|64@1+ (1,0) [0|0] "" Dashboard

VAL_TABLE_ OnOff 0 "Off" 1 "On";
VAL_ 256 Counter 0 "Stopped" 1 "Running";
SIG_VALTYPE_ 256 Ratio : 1;
BO_TX_BU_ 256 : Logger;
SIG_GROUP_ 256 Measurements 1 : Temperature BigEndian;

CM_ "Core fixture";
CM_ BU_ ECU "Controller";
CM_ BO_ 256 "Status message";
CM_ SG_ 256 Temperature "Scaled temperature";
CM_ SG_ 256 Counter "Logged to C:\temp\new as \"count\"
on \\logger";

BA_DEF_ BO_ "GenMsgCycleTime" INT 0 60000;
BA_DEF_ BO_ "GenMsgSendType" ENUM "Cyclic","Event";
BA_DEF_ BO_ "VFrameFormat" ENUM "StandardCAN","ExtendedCAN","reserved","J1939PG","reserved","reserved","reserved","reserved","reserved","reserved","reserved","reserved","reserved","reserved","StandardCAN_FD","ExtendedCAN_FD";
BA_DEF_ BO_ "CANFD_BRS" ENUM "0","1";
BA_DEF_ SG_ "SPN" INT 0 524287;
BA_DEF_ "BusType" STRING;

BA_DEF_DEF_ "GenMsgCycleTime" 0;
BA_DEF_DEF_ "GenMsgSendType" "Event";
BA_DEF_DEF_ "VFrameFormat" "StandardCAN";
BA_DEF_DEF_ "CANFD_BRS" "0";
BA_DEF_DEF_ "SPN" 0;
BA_DEF_DEF_ "BusType" "CAN";

BA_ "BusType" "CAN FD";
BA_ "GenMsgCycleTime" BO_ 256 10;
BA_ "GenMsgSendType" BO_ 256 0;
BA_ "SPN" SG_ 256 Temperature 171;
BA_ "VFrameFormat" BO_ 2149235934 15;
BA_ "CANFD_BRS" BO_ 2149235934 1;
